/*
 * sm5714 battery device tree common
 *
 * Copyright (c) 2021 Samsung Electronics Co., Ltd.
 *		http://www.samsung.com
 *
 * This program is free software; you can redistribute it and/or modify
 * it under the terms of the GNU General Public License version 2 as
 * published by the Free Software Foundation.
 */

&smd {
	sm5714_fuelgauge: sm5714-fuelgauge {
		status = "okay";
		fuelgauge,fuel_alert_soc = <1>;
		fuelgauge,capacity_max = <1000>;
		fuelgauge,capacity_max_margin = <300>;
		fuelgauge,capacity_min = <0>;
		fuelgauge,capacity_calculation_type = <0x1F>;
		fuelgauge,using_temp_compensation;
		fuelgauge,low_temp_limit = <100>;
		fuelgauge,using_hw_vempty;
		fuelgauge,sw_v_empty_voltage = <3200>;
		fuelgauge,sw_v_empty_voltage_cisd = <3100>;
		fuelgauge,sw_v_empty_recover_voltage = <3480>;
		fuelgauge,capacity = <4000>;
#if 0
		fuelgauge,bat_id_gpio = <
				SEC_GPIO_REF(${bat_id_single_gpio}) 0  /* BAT_ID_1 */
				>;
#elif 1
		fuelgauge,bat_id_gpio = <
				SEC_GPIO_REF(AP,tlmm,23) 0  /* BAT_ID_2 */
				SEC_GPIO_REF(AP,tlmm,21) 0  /* BAT_ID_1 */
				>;
#endif

	};
};


&smd {
	battery {
		battery,fgsrc_switch_name = "sm5714-fuelgauge";
	};
};

/* /home/dpi/qb5_8814/workspace/P4_1716/android/kernel/kmodule/battery/suwon/fuelgauge/sm5714/sm5714_fuelgauge.a23xq.dtsi */
/*
 * A23x battery device tree common
 *
 * Copyright (c) 2021 Samsung Electronics Co., Ltd.
 *		http://www.samsung.com
 *
 * This program is free software; you can redistribute it and/or modify
 * it under the terms of the GNU General Public License version 2 as
 * published by the Free Software Foundation.
 */

&sm5714_fuelgauge {
	battery_params {
		battery,id = <3>; /* default ID */
		/*
		 * BAT_ID_1/BAT_ID_2
		 * 11: SDI General Battery, 10: ATL Safety Battery
		 * 01: ATL General Battery, 00: TBD
		 */

		/* 11 : SDI battery data */
		battery3,battery_type = <4420 0x2430>; /* batt_v_max, cap */
		battery3,battery_table0 = <
			0x1400 0x1B1A 0x1C42 0x1CB7 0x1D18 0x1D5F 0x1D78 0x1D8F
			0x1DA5 0x1DE6 0x1E25 0x1E52 0x1E82 0x1EC4 0x1F22 0x1F56
			0x1FA1 0x1FD1 0x202C 0x2092 0x213D 0x21F3 0x22FC 0x2466
			>;
		battery3,battery_table1 = <
			0x0000 0x0066 0x0200 0x0300 0x0400 0x0519 0x0619 0x0BCC
			0x0D66 0x1299 0x1A66 0x1F80 0x274C 0x2F19 0x36E6 0x3980
			0x3C19 0x3EB3 0x43CC 0x4900 0x50CC 0x5899 0x6400 0x6480
			>;
		battery3,battery_table2 = <
			0x444B 0x3E40 0x3B3C 0x3738 0x3435 0x3334 0x3333 0x3233
			0x444B 0x3E40 0x3B3C 0x3738 0x3435 0x3334 0x3333 0x3233
			>;
		/*spare min max factor chg_factor dischg_factor manvalue*/
		battery3,rs_value = <0x48 0x48 0x3800 0x10A 0x599 0x599 0x50>;
		battery3,v_alarm = <3100 200>;
		battery3,topoff = <750>;
		battery3,i_cal = <1 0x0 0x0800 0x0800 0 0x0 0x0800 0x0805>;
		battery3,v_cal = <1 0 0 1 0 0 0>;
		battery3,temp_std = <25>;
		battery3,tem_poff = <3400 50 3250 50>;
		battery3,aux_ctrl = <0x322 0x5800>;
		battery3,data_ver = <1>;
		battery3,v_max_table = <0x22FC 0x22D6 0x22AF 0x2289 0x2228>;
		battery3,q_max_table = <0x2430 0x2381 0x22CF 0x221C 0x2071>;

		/* 01 : ATL battery data */
		battery1,battery_type = <4420 0x23BE>; /* batt_v_max, cap */
		battery1,battery_table0 = <
			0x1400 0x1B82 0x1C44 0x1CC9 0x1D53 0x1D7A 0x1D89 0x1D93
			0x1DC8 0x1DFF 0x1E2D 0x1E5C 0x1E6B 0x1EB7 0x1EEB 0x1F2D
			0x1F5D 0x1FAF 0x200B 0x209E 0x2147 0x2215 0x2300 0x2466
			>;
		battery1,battery_table1 = <
			0x0000 0x00CC 0x01CC 0x02E6 0x0466 0x0580 0x0799 0x0B33
			0x0F66 0x1499 0x19E6 0x1F19 0x21B3 0x2C19 0x314C 0x3699
			0x3933 0x3BCC 0x4100 0x48CC 0x50B3 0x5999 0x6400 0x6480
			>;
		battery1,battery_table2 = <
			0x444B 0x3E40 0x3B3C 0x3738 0x3435 0x3334 0x3333 0x3233
			0x444B 0x3E40 0x3B3C 0x3738 0x3435 0x3334 0x3333 0x3233
			>;
		/*spare min max factor chg_factor dischg_factor manvalue*/
		battery1,rs_value = <0x48 0x48 0x3800 0x10A 0x599 0x599 0x50>;
		battery1,v_alarm = <3100 200>;
		battery1,topoff = <750>;
		battery1,i_cal = <1 0x0 0x0800 0x0800 0 0x0 0x07E9 0x0805>;
		battery1,v_cal = <1 0 0 1 0 0 0>;
		battery1,temp_std = <25>;
		battery1,tem_poff = <3400 50 3250 50>;
		battery1,aux_ctrl = <0x322 0x5800>;
		battery1,data_ver = <2>;
		battery1,v_max_table = <0x2300 0x22DD 0x22B9 0x2296 0x223D>;
		battery1,q_max_table = <0x23BE 0x2307 0x2250 0x2199 0x202B>;

		/* 10 : ATL battery data */
		battery2,battery_type = <4420 0x252D>; /* batt_v_max, cap */
		battery2,battery_table0 = <
			0x1400 0x1B34 0x1C16 0x1CE4 0x1D62 0x1D73 0x1D80 0x1D98
			0x1DAA 0x1DC5 0x1DF4 0x1E44 0x1E5C 0x1E77 0x1EB2 0x1F09
			0x1F46 0x1F89 0x2004 0x2097 0x2140 0x21F8 0x2307 0x2466
			>;
		battery2,battery_table1 = <
			0x0000 0x0099 0x0199 0x0319 0x0499 0x0519 0x0619 0x0BB3
			0x0CB3 0x0EB3 0x12B3 0x1CB3 0x21B3 0x26CC 0x2E4C 0x35CC
			0x384C 0x3ACC 0x4266 0x49E6 0x5166 0x5900 0x6400 0x6480
			>;
		battery2,battery_table2 = <
			0x444B 0x3E40 0x3B3C 0x3738 0x3435 0x3334 0x3333 0x3233
			0x444B 0x3E40 0x3B3C 0x3738 0x3435 0x3334 0x3333 0x3233
			>;
		/*spare min max factor chg_factor dischg_factor manvalue*/
		battery2,rs_value = <0x48 0x48 0x3800 0x10A 0x599 0x599 0x50>;
		battery2,v_alarm = <3100 200>;
		battery2,topoff = <750>;
		battery2,i_cal = <1 0x0 0x0800 0x0800 0 0x0  0x0800 0x0805>;
		battery2,v_cal = <1 0 0 1 0 0 0>;
		battery2,temp_std = <25>;
		battery2,tem_poff = <3400 50 3250 50>;
		battery2,aux_ctrl = <0x322 0x5800>;
		battery2,data_ver = <1>;
		battery2,v_max_table = <0x2307 0x22E4 0x22C1 0x229D 0x2244>;
		battery2,q_max_table = <0x252D 0x246E 0x23B0 0x22F1 0x2175>;
	};
};

/* /home/dpi/qb5_8814/workspace/P4_1716/android/kernel/kmodule/battery/suwon/fuelgauge/sm5714/sm5714_fuelgauge.a23xq_usa_singlew.dtsi */
/*
 * A23x battery device tree common
 *
 * Copyright (c) 2021 Samsung Electronics Co., Ltd.
 *		http://www.samsung.com
 *
 * This program is free software; you can redistribute it and/or modify
 * it under the terms of the GNU General Public License version 2 as
 * published by the Free Software Foundation.
 */

&sm5714_fuelgauge {
	battery_params {
		battery,id = <3>; /* default ID */
		/*
		 * BAT_ID_1/BAT_ID_2
		 * 11: SDI General Battery, 10: ATL Safety Battery
		 * 01: ATL General Battery, 00: TBD
		 */

		/* 11 : SDI battery data */
		battery3,battery_type = <4420 0x23B9>; /* batt_v_max, cap */
		battery3,battery_table0 = <
			0x1400 0x1A5A 0x1B10 0x1B93 0x1C90 0x1CFB 0x1D4F 0x1D75
			0x1D89 0x1DA5 0x1DC7 0x1DFC 0x1E2A 0x1E58 0x1EA0 0x1EEF
			0x1F38 0x1FC1 0x201F 0x2087 0x2134 0x2209 0x22FF 0x2400
			>;
		battery3,battery_table1 = <
			0x0000 0x0066 0x00E6 0x0166 0x0300 0x0419 0x0533 0x0633
			0x0966 0x0DB3 0x1066 0x15B3 0x1B00 0x204C 0x2B00 0x3300
			0x384C 0x3D99 0x4300 0x484C 0x504C 0x594C 0x6400 0x64E6
			>;
		battery3,battery_table2 = <
			0x475D 0x383E 0x3134 0x2A2D 0x2628 0x2425 0x2223 0x2121
			0x475D 0x383E 0x3134 0x2A2D 0x2628 0x2425 0x2223 0x2121
			>;
		/*spare min max factor chg_factor dischg_factor manvalue*/
		battery3,rs_value = <0x0048 0x0048 0x3800 0x010A 0x0599 0x0599 0x0050>;
		battery3,v_alarm = <3100 200>;
		battery3,topoff = <750>;
		battery3,i_cal = <1 0x0 0x0800 0x0800 0 0x0 0x07E6 0x0805>;
		battery3,v_cal = <1 0 0 1 0 0 0>;
		battery3,temp_std = <25>;
		battery3,tem_poff = <3400 50 3250 50>;
		battery3,aux_ctrl = <0x322 0x5800>;
		battery3,data_ver = <2>;
		battery3,v_max_table = <0x22FF 0x22D6 0x22AD 0x2284 0x2229>;
		battery3,q_max_table = <0x23B9 0x238F 0x2366 0x233C 0x2072>;

		/* 01 : ATL battery data */
		battery1,battery_type = <4420 0x244E>; /* batt_v_max, cap */
		battery1,battery_table0 = <
			0x1400 0x1ADA 0x1B6E 0x1C38 0x1CBD 0x1D21 0x1D68 0x1D7D
			0x1D8A 0x1D91 0x1DD4 0x1E20 0x1E54 0x1E86 0x1EC9 0x1F02
			0x1F53 0x1FA5 0x2038 0x20A0 0x214D 0x2221 0x230F 0x2400
			>;
		battery1,battery_table1 = <
			0x0000 0x0080 0x0119 0x0219 0x0333 0x0433 0x054C 0x0666
			0x0900 0x0B99 0x10E6 0x18E6 0x1E33 0x2619 0x2E00 0x334C
			0x3899 0x3B4C 0x4333 0x4880 0x5066 0x5966 0x6400 0x64E6
			>;
		battery1,battery_table2 = <
			0x3B4D 0x2F33 0x292C 0x2326 0x2021 0x1E1F 0x1C1D 0x1B1B
			0x3B4D 0x2F33 0x292C 0x2326 0x2021 0x1E1F 0x1C1D 0x1B1B
			>;
		/*spare min max factor chg_factor dischg_factor manvalue*/
		battery1,rs_value = <0x0048 0x0048 0x3800 0x010A 0x0599 0x0599 0x0050>;
		battery1,v_alarm = <3100 200>;
		battery1,topoff = <750>;
		battery1,i_cal = <1 0x0 0x0800 0x0800 0 0x0 0x07E6 0x0805>;
		battery1,v_cal = <1 0 0 1 0 0 0>;
		battery1,temp_std = <25>;
		battery1,tem_poff = <3400 50 3250 50>;
		battery1,aux_ctrl = <0x322 0x5800>;
		battery1,data_ver = <4>;
		battery1,v_max_table = <0x230F 0x22E6 0x22BD 0x2294 0x2238>;
		battery1,q_max_table = <0x244E 0x2423 0x23F9 0x23CF 0x20F0>;

		/* 10 : ATL battery data */
		battery2,battery_type = <4420 0x252D>; /* batt_v_max, cap */
		battery2,battery_table0 = <
			0x1400 0x1B34 0x1C16 0x1CE4 0x1D62 0x1D73 0x1D80 0x1D98
			0x1DAA 0x1DC5 0x1DF4 0x1E44 0x1E5C 0x1E77 0x1EB2 0x1F09
			0x1F46 0x1F89 0x2004 0x2097 0x2140 0x21F8 0x2307 0x2466
			>;
		battery2,battery_table1 = <
			0x0000 0x0099 0x0199 0x0319 0x0499 0x0519 0x0619 0x0BB3
			0x0CB3 0x0EB3 0x12B3 0x1CB3 0x21B3 0x26CC 0x2E4C 0x35CC
			0x384C 0x3ACC 0x4266 0x49E6 0x5166 0x5900 0x6400 0x6480
			>;
		battery2,battery_table2 = <
			0x444B 0x3E40 0x3B3C 0x3738 0x3435 0x3334 0x3333 0x3233
			0x444B 0x3E40 0x3B3C 0x3738 0x3435 0x3334 0x3333 0x3233
			>;
		/*spare min max factor chg_factor dischg_factor manvalue*/
		battery2,rs_value = <0x48 0x48 0x3800 0x10A 0x599 0x599 0x50>;
		battery2,v_alarm = <3100 200>;
		battery2,topoff = <750>;
		battery2,i_cal = <1 0x0 0x0800 0x0800 0 0x0 0x07E6 0x0805>;
		battery2,v_cal = <1 0 0 1 0 0 0>;
		battery2,temp_std = <25>;
		battery2,tem_poff = <3400 50 3250 50>;
		battery2,aux_ctrl = <0x322 0x5800>;
		battery2,data_ver = <1>;
		battery2,v_max_table = <0x2307 0x22E4 0x22C1 0x229D 0x2244>;
		battery2,q_max_table = <0x252D 0x246E 0x23B0 0x22F1 0x2175>;
	};
};
